// SPDX-License-Identifier: GPL-2.0-or-later OR MIT

#include "mt7621_dlink_dxx-1xx0-x1.dtsi"

/ {
	compatible = "dlink,dra-1360-a1", "mediatek,mt7621-soc";
	model = "D-Link DRA-1360 A1";
};

&hnat {
	mtketh-lan = "eth0.1";
	mtketh-wan = "eth0.2";
	mtketh-max-gmac = <1>;
};
