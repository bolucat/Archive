// SPDX-License-Identifier: GPL-2.0-or-later OR MIT

#include "mt7621_asiarf_ap7621.dtsi"

/ {
	compatible = "asiarf,ap7621-nv1", "mediatek,mt7621-soc";
	model = "AsiaRF AP7621-NV1";
};

&gsw {

		port@2 {
		compatible = "mediatek,mt753x-port";
			status = "okay";
			label = "lan1";
		};

		port@3 {
		compatible = "mediatek,mt753x-port";
			status = "okay";
			label = "lan2";
		};

};
