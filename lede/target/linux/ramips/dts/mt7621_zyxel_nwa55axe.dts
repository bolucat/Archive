#include "mt7621_zyxel_nwa-ax.dtsi"

/ {
	compatible = "zyxel,nwa55axe", "mediatek,mt7621-soc";
	model = "Zyxel NWA55AXE";
};

&hnat {
	mtketh-lan = "eth0.1";
	mtketh-wan = "eth0.2";
	mtketh-max-gmac = <1>;
};
