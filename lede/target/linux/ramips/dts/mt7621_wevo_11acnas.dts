#include "mt7621_wevo_w2914ns-v2.dtsi"

/ {
	compatible = "wevo,11acnas", "mediatek,mt7621-soc";
	model = "WeVO 11AC NAS Router";
};

&hnat {
	mtketh-lan = "eth0.1";
	mtketh-wan = "eth0.2";
	mtketh-max-gmac = <1>;
};
