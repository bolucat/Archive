// SPDX-License-Identifier: GPL-2.0-or-later OR MIT

#include "mt7621_tplink_archer-x6-v3.dtsi"

/ {
	compatible = "tplink,archer-a6-v3", "mediatek,mt7621-soc";
	model = "TP-Link Archer A6 v3";

};

&hnat {
	mtketh-lan = "eth0.1";
	mtketh-wan = "eth0.2";
	mtketh-max-gmac = <1>;
};
