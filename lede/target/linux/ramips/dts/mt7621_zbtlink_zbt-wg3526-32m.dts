#include "mt7621_zbtlink_zbt-wg3526.dtsi"

/ {
	compatible = "zbtlink,zbt-wg3526-32m", "zbtlink,zbt-wg3526", "mediatek,mt7621-soc";
	model = "Zbtlink ZBT-WG3526 (32M)";
};

&flash0 {
	broken-flash-reset;
};

&firmware {
	reg = <0x50000 0x1fb0000>;
};

&hnat {
	mtketh-lan = "eth0.1";
	mtketh-wan = "eth0.2";
	mtketh-max-gmac = <1>;
};
