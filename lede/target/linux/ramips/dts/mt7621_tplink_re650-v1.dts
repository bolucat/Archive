// SPDX-License-Identifier: GPL-2.0-or-later OR MIT

#include "mt7621_tplink_rexx0-v1.dtsi"

/ {
	compatible = "tplink,re650-v1", "mediatek,mt7621-soc";
	model = "TP-Link RE650 v1";
};

&hnat {
	mtketh-lan = "eth0.1";
	mtketh-wan = "eth0.2";
	mtketh-max-gmac = <1>;
};
