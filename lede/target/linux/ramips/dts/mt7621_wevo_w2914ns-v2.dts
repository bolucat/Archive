#include "mt7621_wevo_w2914ns-v2.dtsi"

/ {
	compatible = "wevo,w2914ns-v2", "mediatek,mt7621-soc";
	model = "WeVO W2914NS v2";
};

&hnat {
	mtketh-lan = "eth0.1";
	mtketh-wan = "eth0.2";
	mtketh-max-gmac = <1>;
};
